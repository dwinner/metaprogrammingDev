variables
{
   multiplexed_message MP_msg_type MP_msg;
   const message gDiagIPCPhysicalRequest_const diagnosticTesterPresent_msg;
   message * eAll1, eAll2;
   message EngData engMsg;
   message * allMsg;
   message 100 decimalMsg; // CAN message
   message wake-up wakeUpMsg;
   message 100 yaDecMsg; // creates message 100
   message 0x555 dlcMsg1 = {dlc = 1}, dlcMsg2 = {dlc = 2};
   message 0x400 yaDlcMsg = {dlc=1};
   message 0x100 eTempDlc = {DLC = 8};
   message 0x100 msgToSend = {dlc = 8}; // declare message to send
   message 0x555 eHexMsg = {dlc=1};
}
