int & refReturn ( int param1 )
{
}

struct MyStruct & f3 (
   int             param1,
   char            param2
  )
{
}

int refParamsCombined (
   const MyType        &param1,
   int                  param2
  )
  {
  }

MyType1 allRefParamsCustomTypeReturn (
   MyType        &param1,
   int       &     param2
  ) {}
  
on sysvar_update sysvar :: ASG_AudioSD::MeImSe_InID
{
}

on sysvar sysvar :: ASG_AudioSD::MeImSe_InID
{
}