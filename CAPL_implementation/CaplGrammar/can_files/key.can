on key 'a' // when the 'a' key is pressed
{
    setTimer(myTimer,20); // set myTimer to 20 ms
    setTimer(timer1, 100); // initialize timer to run for 100 msec
}

on key 't'
{
}

on key *
{
}

on key F1
{
}

on key PageUp
{
}

on key 0x4F00
{
}

on key 'a'
{
    write ("Key >a< pressed");
}

on key ' '
{
    write ("Key >a< pressed");
}

on key 0x20
{
    write ("Key >a< pressed");
}

on key F10
{
    write ("Key >a< pressed");
}

on key ctrlF12
{
    write ("Key >a< pressed");
}

on key PageUp
{
    write ("Key >a< pressed");
}

on key Home
{
    write ("Key >a< pressed");
}

on key *
{
    write ("Key >a< pressed");
}

on key '1'
{
    //To enable all Logging blocks and bypass all
    //triggering conditions:
    startLogging();
    //To enable a specific Logging block and bypass all
    //triggering conditions:
    startLogging("loggingblockname");
    //To enable a specific Logging block with a specific
    //pre-trigger time and bypass all triggering conditions:
    startLogging("loggingblockname", 1000);
}

on key '2'
{
    //To disable all Logging blocks and bypass all
    //triggering conditions:
    stopLogging();
    //To disable a specific Logging block and bypass all
    //triggering conditions:
    stopLogging("loggingblockname");
    //To disable a specific Logging block with a specific
    //post-trigger time and bypass all triggering
    //conditions:
    stopLogging("loggingblockname", 2000);
}

on key PageUp 
{
   @eKeyWheelEventCodeLeft_P1=1;
   LastKey = keypressed();
   if (!isTimerActive(KeyReleaseTimer))
      setTimer(KeyReleaseTimer,100);
}

on key PageDown
{
   @eKeyWheelEventCodeLeft_M1=1;
   LastKey = keypressed();
   if (!isTimerActive(KeyReleaseTimer))
      setTimer(KeyReleaseTimer,100);
}

on key 'm'
{
   @eKeyMenuState=1;
   LastKey = keypressed();
   if (!isTimerActive(KeyReleaseTimer))
      setTimer(KeyReleaseTimer,100);
}

on key 0x4F00
{
   if (@eNMHControllerNodeAwake)
      @eNMHControllerNodeAwake=0;
   else
      @eNMHControllerNodeAwake=1;
}

on key 0x4700
{
   if (@eZAS_Kl_15S==1)
      @eZAS_Kl_15S=0;
   else
      @eZAS_Kl_15S=1;
}

on key 'b'
{
    msg1.byte(0)=0xAA;
    output(msg1);
}