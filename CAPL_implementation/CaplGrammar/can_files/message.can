variables
{
   message * eAll1, eAll2;
   message EngData engMsg;
   message * allMsg;
   message 100 decimalMsg; // CAN message
   message wake-up wakeUpMsg;
   message 100 yaDecMsg; // creates message 100
   message 0x555 dlcMsg1 = {dlc = 1}, dlcMsg2 = {dlc = 2};
   message 0x400 yaDlcMsg = {dlc=1};
   message 0x100 eTempDlc = {DLC = 8};
   message 0x100 msgToSend = {dlc = 8}; // declare message to send
   message 0x555 eHexMsg = {dlc=1};
}

/* receiving many messages */
on message  engMsg,            
            MeacIC_5,
            MeasIC_3
{
}

/* receiving ranges */
on message CAN1.0x500 - 0x57F
{
}

on message CAN1.0x500-0x57F
{
}

on message engMsg
{
   engMsg.EngSpeed = 50000; // sets raw value, the same value on the bus
   engMsg.EngSpeed.phys = 50000; // sets physical value

   msg1.byte(0) = 0x12; // set the data field
   msg1.long(1) = 0x90785634;
   msg1.CarSpeed = 100; // assume CarSpeed occupies the last three bytes
   msg1.CAN = 2;
   output(msg1); // send the message
}

on message eTemp
{
   eTemp.CAN = 2; // set the transmit channel for this message to 2
   int value = eTemp.TIME; // retrieve the time stamp of a message’s last transmission or reception
   eTemp.ID = 100; // set the message identifier to 100 in decimal

   int myValue;

   myvalue = eTemp.WORD(2); // initialize the integer to 0x51FF
   myvalue >>= 4; // shift 0x51FF to the right 4 bits to get 0x51F
   myvalue &= 0xFF; // clears all unnecessary bits to get 0x1F
}

/* Message event variants */
on message can2.0x100
{
}

on message 0x1B000000x-0x1B00007Fx
{
}

on message 0x1B000000x-0x1B00007F
{
}

on message 0x1B000000 - 0x1B00007Fx
{
}

on message 0x1B000000x - 0x1B00007Fx
{
}

on message 0x1B000000X-0x1B00007FX
{
}

on message 0x131
{
}

on message 100
{
}

On Message BAPonly::BAPAudi
{
}

on message 0x500-0x57F
{
}

on message 0x500 - 0x57F
{
}

on message 0x1B000000x-0x1B00007Fx
{
}

on message 0x1B000000x - 0x1B00007Fx
{
}

on message Meas_IC_4
{
}

on message simpleMessage
{
}

on message simpleMessage . *
{
}

on message simpleMessage . subMessage
{
}

on message 100 // this example triggers all the Logging blocks
{
   writeToLog("Logging starts");
   
   // this example sets the pre-trigger time before logging to 25 milliseconds:
   setPreTrigger(25);
   trigger(); // start logging
}

on message 555
{
   byte val;
   val = 0;

   /* checks to see if the message was received on CAN channel 1*/
   if (this.CAN == 1)
   {
      // sets "val" to the value of the first data byte in the CAN message
      val = this.byte(0);
   }
}

on message CAN2.0x100 // for messages with ID equal to 0x100 from CAN channel 2
{
   // print
   write("The message with ID 0x100 is received from CAN channel 2.");
}

on message 0x100 // for messages with ID equal to 100 in hex only
{
   // print
   write("The message with ID 0x100 is received.");
}

on message 0x123
{
   write ("CAN Message 123");
}

on message EngineState
{
    @sysvar::Engine::EngineSpeedDspMeter = this.EngineSpeed / 1000.0;
}

on message CAN1.*
{
   message CAN2.* msg;
   if(this.dir != rx) return; //important!
   msg = this;
   output(msg);
}

on message CAN2.*
{
   message CAN1.* msg;
   if(this.dir != rx)
   {
       return; //important!
   }    
   
   msg = this;
   output(msg);
}

on message *
{
   if (getValue(eChannel))
   {                        
      if (this.can==1) /*&& (this.dir==TX))*/
	   {                
         this.can=2;                   
		   output(this);
	   }
   }
}